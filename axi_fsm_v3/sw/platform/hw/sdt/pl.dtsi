/ {
	amba_pl: amba_pl {
		ranges;
		compatible = "simple-bus";
		#address-cells = <1>;
		#size-cells = <1>;
		top_0: top@40000000 {
			compatible = "xlnx,top-1.0";
			xlnx,rable = <0>;
			xlnx,s00-axi-data-width = <32>;
			xlnx,ip-name = "top";
			reg = <0x40000000 0x1000>;
			xlnx,cnt-bit = <31>;
			clocks = <&clkc 15>;
			xlnx,edk-iptype = "PERIPHERAL";
			status = "okay";
			xlnx,s00-axi-addr-width = <4>;
			clock-names = "s00_axi_aclk";
			xlnx,name = "top_0";
		};
	};
};
